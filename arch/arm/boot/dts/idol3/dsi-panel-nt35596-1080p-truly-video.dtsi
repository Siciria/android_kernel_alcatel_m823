/* Copyright (c) 2013-2014, The Linux Foundation. All rights reserved.
 *
 * This program is free software; you can redistribute it and/or modify
 * it under the terms of the GNU General Public License version 2 and
 * only version 2 as published by the Free Software Foundation.
 *
 * This program is distributed in the hope that it will be useful,
 * but WITHOUT ANY WARRANTY; without even the implied warranty of
 * MERCHANTABILITY or FITNESS FOR A PARTICULAR PURPOSE.  See the
 * GNU General Public License for more details.
 */

/*---------------------------------------------------------------------------
 * This file is autogenerated file using gcdb parser. Please do not edit it.
 * Update input XML file to add a new entry or update variable in this file
 * VERSION = "1.0"
 *---------------------------------------------------------------------------*/
 
&mdss_mdp {
	dsi_nt35596_1080p_truly_vid: qcom,mdss_dsi_nt35596_1080p_truly_video{
		compatible = "qcom,mdss-dsi-panel";
		status = "disable";
		qcom,mdss-dsi-panel-name = "nt35596 1080p videomode panel (truly)";
		qcom,mdss-dsi-panel-controller = <&mdss_dsi0>;
		qcom,mdss-dsi-panel-type = "dsi_video_mode";
		qcom,mdss-dsi-panel-destination = "display_1";
		qcom,mdss-dsi-pixel-packing = <0>; /* used for 16bit mode*/
        	qcom,mdss-dsi-panel-framerate = <60>;
        	qcom,mdss-dsi-virtual-channel-id = <0>;
		qcom,mdss-dsi-stream = <0>;
		qcom,mdss-dsi-panel-width = <1080>;
		qcom,mdss-dsi-panel-height = <1920>;
		qcom,mdss-dsi-h-front-porch = <32>;
		qcom,mdss-dsi-h-back-porch = <32>;
		qcom,mdss-dsi-h-pulse-width = <8>;
		qcom,mdss-dsi-h-sync-skew = <0>;
		qcom,mdss-dsi-v-back-porch = <4>;
		qcom,mdss-dsi-v-front-porch = <4>;
		qcom,mdss-dsi-v-pulse-width = <2>;
		qcom,mdss-dsi-h-left-border = <0>;
		qcom,mdss-dsi-h-right-border = <0>;
		qcom,mdss-dsi-v-top-border = <0>;
		qcom,mdss-dsi-v-bottom-border = <0>;
		qcom,mdss-pan-physical-width-dimension = <68>;
		qcom,mdss-pan-physical-height-dimension = <121>;
		qcom,mdss-dsi-bpp = <24>;
		qcom,mdss-dsi-color-order = "rgb_swap_rgb";
		qcom,mdss-dsi-underflow-color = <0xff>;
		qcom,mdss-dsi-border-color = <0>;
		qcom,mdss-dsi-reset-command = [
            	05 01 00 00 78 00 02 11 00
            	05 01 00 00 14 00 02 29 00
            	05 01 00 00 14 00 02 38 00
        	];
		qcom,mdss-dsi-on-command = [
		15 01 00 00 00 00 02 ff ee 
		15 01 00 00 00 00 02 7c 31 
		15 01 00 00 00 00 02 fb 01 
		15 01 00 00 00 00 02 ff 01 
		15 01 00 00 00 00 02 00 01 
		15 01 00 00 00 00 02 01 55 
		15 01 00 00 00 00 02 02 40 
		15 01 00 00 00 00 02 05 50 
		15 01 00 00 00 00 02 06 4a 
		15 01 00 00 00 00 02 07 29 
		15 01 00 00 00 00 02 08 0c 
		15 01 00 00 00 00 02 0b 87 
		15 01 00 00 00 00 02 0c 87 
		15 01 00 00 00 00 02 0e b0 
		15 01 00 00 00 00 02 0f b3 
		15 01 00 00 00 00 02 11 2a 
		15 01 00 00 00 00 02 12 2a 
		15 01 00 00 00 00 02 13 03 
		15 01 00 00 00 00 02 14 4a 
		15 01 00 00 00 00 02 15 12 
		15 01 00 00 00 00 02 16 12 
		15 01 00 00 00 00 02 18 00 
		15 01 00 00 00 00 02 19 77 
		15 01 00 00 00 00 02 1a 55 
		15 01 00 00 00 00 02 1b 13 
		15 01 00 00 00 00 02 1c 00 
		15 01 00 00 00 00 02 1d 00 
		15 01 00 00 00 00 02 1e 00 
		15 01 00 00 00 00 02 1f 00 
		15 01 00 00 00 00 02 58 82 
		15 01 00 00 00 00 02 59 02 
		15 01 00 00 00 00 02 5a 02 
		15 01 00 00 00 00 02 5b 02 
		15 01 00 00 00 00 02 5c 82 
		15 01 00 00 00 00 02 5d 82 
		15 01 00 00 00 00 02 5e 02 
		15 01 00 00 00 00 02 5f 02 
		15 01 00 00 00 00 02 72 31 
		15 01 00 00 00 00 02 fb 01 
		15 01 00 00 00 00 02 ff 01 
		15 01 00 00 00 00 02 68 13 
		15 01 00 00 00 00 02 fb 01 
		15 01 00 00 00 00 02 75 00 
		15 01 00 00 00 00 02 76 00 
		15 01 00 00 00 00 02 77 00 
		15 01 00 00 00 00 02 78 48 
		15 01 00 00 00 00 02 79 00 
		15 01 00 00 00 00 02 7a 75 
		15 01 00 00 00 00 02 7b 00 
		15 01 00 00 00 00 02 7c 92 
		15 01 00 00 00 00 02 7d 00 
		15 01 00 00 00 00 02 7e aa 
		15 01 00 00 00 00 02 7f 00 
		15 01 00 00 00 00 02 80 bd 
		15 01 00 00 00 00 02 81 00 
		15 01 00 00 00 00 02 82 ce 
		15 01 00 00 00 00 02 83 00 
		15 01 00 00 00 00 02 84 dd 
		15 01 00 00 00 00 02 85 00 
		15 01 00 00 00 00 02 86 eb 
		15 01 00 00 00 00 02 87 01 
		15 01 00 00 00 00 02 88 18 
		15 01 00 00 00 00 02 89 01 
		15 01 00 00 00 00 02 8a 3c 
		15 01 00 00 00 00 02 8b 01 
		15 01 00 00 00 00 02 8c 75 
		15 01 00 00 00 00 02 8d 01 
		15 01 00 00 00 00 02 8e a1 
		15 01 00 00 00 00 02 8f 01 
		15 01 00 00 00 00 02 90 e6 
		15 01 00 00 00 00 02 91 02 
		15 01 00 00 00 00 02 92 1d 
		15 01 00 00 00 00 02 93 02 
		15 01 00 00 00 00 02 94 1e 
		15 01 00 00 00 00 02 95 02 
		15 01 00 00 00 00 02 96 53 
		15 01 00 00 00 00 02 97 02 
		15 01 00 00 00 00 02 98 93 
		15 01 00 00 00 00 02 99 02 
		15 01 00 00 00 00 02 9a ba 
		15 01 00 00 00 00 02 9b 02 
		15 01 00 00 00 00 02 9c e9 
		15 01 00 00 00 00 02 9d 03 
		15 01 00 00 00 00 02 9e 08 
		15 01 00 00 00 00 02 9f 03 
		15 01 00 00 00 00 02 a0 33 
		15 01 00 00 00 00 02 a2 03 
		15 01 00 00 00 00 02 a3 41 
		15 01 00 00 00 00 02 a4 03 
		15 01 00 00 00 00 02 a5 50 
		15 01 00 00 00 00 02 a6 03 
		15 01 00 00 00 00 02 a7 61 
		15 01 00 00 00 00 02 a9 03 
		15 01 00 00 00 00 02 aa 75 
		15 01 00 00 00 00 02 ab 03 
		15 01 00 00 00 00 02 ac 8e 
		15 01 00 00 00 00 02 ad 03 
		15 01 00 00 00 00 02 ae af 
		15 01 00 00 00 00 02 af 03 
		15 01 00 00 00 00 02 b0 cc 
		15 01 00 00 00 00 02 b1 03 
		15 01 00 00 00 00 02 b2 d0 
		15 01 00 00 00 00 02 b3 00 
		15 01 00 00 00 00 02 b4 00 
		15 01 00 00 00 00 02 b5 00 
		15 01 00 00 00 00 02 b6 48 
		15 01 00 00 00 00 02 b7 00 
		15 01 00 00 00 00 02 b8 75 
		15 01 00 00 00 00 02 b9 00 
		15 01 00 00 00 00 02 ba 92 
		15 01 00 00 00 00 02 bb 00 
		15 01 00 00 00 00 02 bc aa 
		15 01 00 00 00 00 02 bd 00 
		15 01 00 00 00 00 02 be bd 
		15 01 00 00 00 00 02 bf 00 
		15 01 00 00 00 00 02 c0 ce 
		15 01 00 00 00 00 02 c1 00 
		15 01 00 00 00 00 02 c2 dd 
		15 01 00 00 00 00 02 c3 00 
		15 01 00 00 00 00 02 c4 eb 
		15 01 00 00 00 00 02 c5 01 
		15 01 00 00 00 00 02 c6 18 
		15 01 00 00 00 00 02 c7 01 
		15 01 00 00 00 00 02 c8 3c 
		15 01 00 00 00 00 02 c9 01 
		15 01 00 00 00 00 02 ca 75 
		15 01 00 00 00 00 02 cb 01 
		15 01 00 00 00 00 02 cc a1 
		15 01 00 00 00 00 02 cd 01 
		15 01 00 00 00 00 02 ce e6 
		15 01 00 00 00 00 02 cf 02 
		15 01 00 00 00 00 02 d0 1d 
		15 01 00 00 00 00 02 d1 02 
		15 01 00 00 00 00 02 d2 1e 
		15 01 00 00 00 00 02 d3 02 
		15 01 00 00 00 00 02 d4 53 
		15 01 00 00 00 00 02 d5 02 
		15 01 00 00 00 00 02 d6 93 
		15 01 00 00 00 00 02 d7 02 
		15 01 00 00 00 00 02 d8 ba 
		15 01 00 00 00 00 02 d9 02 
		15 01 00 00 00 00 02 da e9 
		15 01 00 00 00 00 02 db 03 
		15 01 00 00 00 00 02 dc 08 
		15 01 00 00 00 00 02 dd 03 
		15 01 00 00 00 00 02 de 33 
		15 01 00 00 00 00 02 df 03 
		15 01 00 00 00 00 02 e0 41 
		15 01 00 00 00 00 02 e1 03 
		15 01 00 00 00 00 02 e2 50 
		15 01 00 00 00 00 02 e3 03 
		15 01 00 00 00 00 02 e4 61 
		15 01 00 00 00 00 02 e5 03 
		15 01 00 00 00 00 02 e6 75 
		15 01 00 00 00 00 02 e7 03 
		15 01 00 00 00 00 02 e8 8e 
		15 01 00 00 00 00 02 e9 03 
		15 01 00 00 00 00 02 ea af 
		15 01 00 00 00 00 02 eb 03 
		15 01 00 00 00 00 02 ec cc 
		15 01 00 00 00 00 02 ed 03 
		15 01 00 00 00 00 02 ee d0 
		15 01 00 00 00 00 02 ef 00 
		15 01 00 00 00 00 02 f0 00 
		15 01 00 00 00 00 02 f1 00 
		15 01 00 00 00 00 02 f2 48 
		15 01 00 00 00 00 02 f3 00 
		15 01 00 00 00 00 02 f4 75 
		15 01 00 00 00 00 02 f5 00 
		15 01 00 00 00 00 02 f6 92 
		15 01 00 00 00 00 02 f7 00 
		15 01 00 00 00 00 02 f8 aa 
		15 01 00 00 00 00 02 f9 00 
		15 01 00 00 00 00 02 fa bd 
		15 01 00 00 00 00 02 ff 02 
		15 01 00 00 00 00 02 fb 01 
		15 01 00 00 00 00 02 00 00 
		15 01 00 00 00 00 02 01 ce 
		15 01 00 00 00 00 02 02 00 
		15 01 00 00 00 00 02 03 dd 
		15 01 00 00 00 00 02 04 00 
		15 01 00 00 00 00 02 05 eb 
		15 01 00 00 00 00 02 06 01 
		15 01 00 00 00 00 02 07 18 
		15 01 00 00 00 00 02 08 01 
		15 01 00 00 00 00 02 09 3c 
		15 01 00 00 00 00 02 0a 01 
		15 01 00 00 00 00 02 0b 75 
		15 01 00 00 00 00 02 0c 01 
		15 01 00 00 00 00 02 0d a1 
		15 01 00 00 00 00 02 0e 01 
		15 01 00 00 00 00 02 0f e6 
		15 01 00 00 00 00 02 10 02 
		15 01 00 00 00 00 02 11 1d 
		15 01 00 00 00 00 02 12 02 
		15 01 00 00 00 00 02 13 1e 
		15 01 00 00 00 00 02 14 02 
		15 01 00 00 00 00 02 15 53 
		15 01 00 00 00 00 02 16 02 
		15 01 00 00 00 00 02 17 93 
		15 01 00 00 00 00 02 18 02 
		15 01 00 00 00 00 02 19 ba 
		15 01 00 00 00 00 02 1a 02 
		15 01 00 00 00 00 02 1b e9 
		15 01 00 00 00 00 02 1c 03 
		15 01 00 00 00 00 02 1d 08 
		15 01 00 00 00 00 02 1e 03 
		15 01 00 00 00 00 02 1f 33 
		15 01 00 00 00 00 02 20 03 
		15 01 00 00 00 00 02 21 41 
		15 01 00 00 00 00 02 22 03 
		15 01 00 00 00 00 02 23 50 
		15 01 00 00 00 00 02 24 03 
		15 01 00 00 00 00 02 25 61 
		15 01 00 00 00 00 02 26 03 
		15 01 00 00 00 00 02 27 75 
		15 01 00 00 00 00 02 28 03 
		15 01 00 00 00 00 02 29 8e 
		15 01 00 00 00 00 02 2a 03 
		15 01 00 00 00 00 02 2b af 
		15 01 00 00 00 00 02 2d 03 
		15 01 00 00 00 00 02 2f cc 
		15 01 00 00 00 00 02 30 03 
		15 01 00 00 00 00 02 31 d0 
		15 01 00 00 00 00 02 32 00 
		15 01 00 00 00 00 02 33 00 
		15 01 00 00 00 00 02 34 00 
		15 01 00 00 00 00 02 35 48 
		15 01 00 00 00 00 02 36 00 
		15 01 00 00 00 00 02 37 75 
		15 01 00 00 00 00 02 38 00 
		15 01 00 00 00 00 02 39 92 
		15 01 00 00 00 00 02 3a 00 
		15 01 00 00 00 00 02 3b aa 
		15 01 00 00 00 00 02 3d 00 
		15 01 00 00 00 00 02 3f bd 
		15 01 00 00 00 00 02 40 00 
		15 01 00 00 00 00 02 41 ce 
		15 01 00 00 00 00 02 42 00 
		15 01 00 00 00 00 02 43 dd 
		15 01 00 00 00 00 02 44 00 
		15 01 00 00 00 00 02 45 eb 
		15 01 00 00 00 00 02 46 01 
		15 01 00 00 00 00 02 47 18 
		15 01 00 00 00 00 02 48 01 
		15 01 00 00 00 00 02 49 3c 
		15 01 00 00 00 00 02 4a 01 
		15 01 00 00 00 00 02 4b 75 
		15 01 00 00 00 00 02 4c 01 
		15 01 00 00 00 00 02 4d a1 
		15 01 00 00 00 00 02 4e 01 
		15 01 00 00 00 00 02 4f e6 
		15 01 00 00 00 00 02 50 02 
		15 01 00 00 00 00 02 51 1d 
		15 01 00 00 00 00 02 52 02 
		15 01 00 00 00 00 02 53 1e 
		15 01 00 00 00 00 02 54 02 
		15 01 00 00 00 00 02 55 53 
		15 01 00 00 00 00 02 56 02 
		15 01 00 00 00 00 02 58 93 
		15 01 00 00 00 00 02 59 02 
		15 01 00 00 00 00 02 5a ba 
		15 01 00 00 00 00 02 5b 02 
		15 01 00 00 00 00 02 5c e9 
		15 01 00 00 00 00 02 5d 03 
		15 01 00 00 00 00 02 5e 08 
		15 01 00 00 00 00 02 5f 03 
		15 01 00 00 00 00 02 60 33 
		15 01 00 00 00 00 02 61 03 
		15 01 00 00 00 00 02 62 41 
		15 01 00 00 00 00 02 63 03 
		15 01 00 00 00 00 02 64 50 
		15 01 00 00 00 00 02 65 03 
		15 01 00 00 00 00 02 66 61 
		15 01 00 00 00 00 02 67 03 
		15 01 00 00 00 00 02 68 75 
		15 01 00 00 00 00 02 69 03 
		15 01 00 00 00 00 02 6a 8e 
		15 01 00 00 00 00 02 6b 03 
		15 01 00 00 00 00 02 6c af 
		15 01 00 00 00 00 02 6d 03 
		15 01 00 00 00 00 02 6e cc 
		15 01 00 00 00 00 02 6f 03 
		15 01 00 00 00 00 02 70 d0 
		15 01 00 00 00 00 02 71 00 
		15 01 00 00 00 00 02 72 00 
		15 01 00 00 00 00 02 73 00 
		15 01 00 00 00 00 02 74 48 
		15 01 00 00 00 00 02 75 00 
		15 01 00 00 00 00 02 76 75 
		15 01 00 00 00 00 02 77 00 
		15 01 00 00 00 00 02 78 92 
		15 01 00 00 00 00 02 79 00 
		15 01 00 00 00 00 02 7a aa 
		15 01 00 00 00 00 02 7b 00 
		15 01 00 00 00 00 02 7c bd 
		15 01 00 00 00 00 02 7d 00 
		15 01 00 00 00 00 02 7e ce 
		15 01 00 00 00 00 02 7f 00 
		15 01 00 00 00 00 02 80 dd 
		15 01 00 00 00 00 02 81 00 
		15 01 00 00 00 00 02 82 eb 
		15 01 00 00 00 00 02 83 01 
		15 01 00 00 00 00 02 84 18 
		15 01 00 00 00 00 02 85 01 
		15 01 00 00 00 00 02 86 3c 
		15 01 00 00 00 00 02 87 01 
		15 01 00 00 00 00 02 88 75 
		15 01 00 00 00 00 02 89 01 
		15 01 00 00 00 00 02 8a a1 
		15 01 00 00 00 00 02 8b 01 
		15 01 00 00 00 00 02 8c e6 
		15 01 00 00 00 00 02 8d 02 
		15 01 00 00 00 00 02 8e 1d 
		15 01 00 00 00 00 02 8f 02 
		15 01 00 00 00 00 02 90 1e 
		15 01 00 00 00 00 02 91 02 
		15 01 00 00 00 00 02 92 53 
		15 01 00 00 00 00 02 93 02 
		15 01 00 00 00 00 02 94 93 
		15 01 00 00 00 00 02 95 02 
		15 01 00 00 00 00 02 96 ba 
		15 01 00 00 00 00 02 97 02 
		15 01 00 00 00 00 02 98 e9 
		15 01 00 00 00 00 02 99 03 
		15 01 00 00 00 00 02 9a 08 
		15 01 00 00 00 00 02 9b 03 
		15 01 00 00 00 00 02 9c 33 
		15 01 00 00 00 00 02 9d 03 
		15 01 00 00 00 00 02 9e 41 
		15 01 00 00 00 00 02 9f 03 
		15 01 00 00 00 00 02 a0 50 
		15 01 00 00 00 00 02 a2 03 
		15 01 00 00 00 00 02 a3 61 
		15 01 00 00 00 00 02 a4 03 
		15 01 00 00 00 00 02 a5 75 
		15 01 00 00 00 00 02 a6 03 
		15 01 00 00 00 00 02 a7 8e 
		15 01 00 00 00 00 02 a9 03 
		15 01 00 00 00 00 02 aa af 
		15 01 00 00 00 00 02 ab 03 
		15 01 00 00 00 00 02 ac cc 
		15 01 00 00 00 00 02 ad 03 
		15 01 00 00 00 00 02 ae d0 
		15 01 00 00 00 00 02 af 00 
		15 01 00 00 00 00 02 b0 00 
		15 01 00 00 00 00 02 b1 00 
		15 01 00 00 00 00 02 b2 48 
		15 01 00 00 00 00 02 b3 00 
		15 01 00 00 00 00 02 b4 75 
		15 01 00 00 00 00 02 b5 00 
		15 01 00 00 00 00 02 b6 92 
		15 01 00 00 00 00 02 b7 00 
		15 01 00 00 00 00 02 b8 aa 
		15 01 00 00 00 00 02 b9 00 
		15 01 00 00 00 00 02 ba bd 
		15 01 00 00 00 00 02 bb 00 
		15 01 00 00 00 00 02 bc ce 
		15 01 00 00 00 00 02 bd 00 
		15 01 00 00 00 00 02 be dd 
		15 01 00 00 00 00 02 bf 00 
		15 01 00 00 00 00 02 c0 eb 
		15 01 00 00 00 00 02 c1 01 
		15 01 00 00 00 00 02 c2 18 
		15 01 00 00 00 00 02 c3 01 
		15 01 00 00 00 00 02 c4 3c 
		15 01 00 00 00 00 02 c5 01 
		15 01 00 00 00 00 02 c6 75 
		15 01 00 00 00 00 02 c7 01 
		15 01 00 00 00 00 02 c8 a1 
		15 01 00 00 00 00 02 c9 01 
		15 01 00 00 00 00 02 ca e6 
		15 01 00 00 00 00 02 cb 02 
		15 01 00 00 00 00 02 cc 1d 
		15 01 00 00 00 00 02 cd 02 
		15 01 00 00 00 00 02 ce 1e 
		15 01 00 00 00 00 02 cf 02 
		15 01 00 00 00 00 02 d0 53 
		15 01 00 00 00 00 02 d1 02 
		15 01 00 00 00 00 02 d2 93 
		15 01 00 00 00 00 02 d3 02 
		15 01 00 00 00 00 02 d4 ba 
		15 01 00 00 00 00 02 d5 02 
		15 01 00 00 00 00 02 d6 e9 
		15 01 00 00 00 00 02 d7 03 
		15 01 00 00 00 00 02 d8 08 
		15 01 00 00 00 00 02 d9 03 
		15 01 00 00 00 00 02 da 33 
		15 01 00 00 00 00 02 db 03 
		15 01 00 00 00 00 02 dc 41 
		15 01 00 00 00 00 02 dd 03 
		15 01 00 00 00 00 02 de 50 
		15 01 00 00 00 00 02 df 03 
		15 01 00 00 00 00 02 e0 61 
		15 01 00 00 00 00 02 e1 03 
		15 01 00 00 00 00 02 e2 75 
		15 01 00 00 00 00 02 e3 03 
		15 01 00 00 00 00 02 e4 8e 
		15 01 00 00 00 00 02 e5 03 
		15 01 00 00 00 00 02 e6 af 
		15 01 00 00 00 00 02 e7 03 
		15 01 00 00 00 00 02 e8 cc 
		15 01 00 00 00 00 02 e9 03 
		15 01 00 00 00 00 02 ea d0 
		15 01 00 00 00 00 02 ff 05 
		15 01 00 00 00 00 02 00 01 
		15 01 00 00 00 00 02 01 0b 
		15 01 00 00 00 00 02 02 0c 
		15 01 00 00 00 00 02 03 09 
		15 01 00 00 00 00 02 04 0a 
		15 01 00 00 00 00 02 05 00 
		15 01 00 00 00 00 02 06 0f 
		15 01 00 00 00 00 02 07 10 
		15 01 00 00 00 00 02 08 1a 
		15 01 00 00 00 00 02 09 00 
		15 01 00 00 00 00 02 0a 00 
		15 01 00 00 00 00 02 0b 00 
		15 01 00 00 00 00 02 0c 00 
		15 01 00 00 00 00 02 0d 13 
		15 01 00 00 00 00 02 0e 15 
		15 01 00 00 00 00 02 0f 17 
		15 01 00 00 00 00 02 10 01 
		15 01 00 00 00 00 02 11 0b 
		15 01 00 00 00 00 02 12 0c 
		15 01 00 00 00 00 02 13 09 
		15 01 00 00 00 00 02 14 0a 
		15 01 00 00 00 00 02 15 00 
		15 01 00 00 00 00 02 16 0f 
		15 01 00 00 00 00 02 17 10 
		15 01 00 00 00 00 02 18 1a 
		15 01 00 00 00 00 02 19 00 
		15 01 00 00 00 00 02 1a 00 
		15 01 00 00 00 00 02 1b 00 
		15 01 00 00 00 00 02 1c 00 
		15 01 00 00 00 00 02 1d 13 
		15 01 00 00 00 00 02 1e 15 
		15 01 00 00 00 00 02 1f 17 
		15 01 00 00 00 00 02 20 00 
		15 01 00 00 00 00 02 21 01 
		15 01 00 00 00 00 02 22 00 
		15 01 00 00 00 00 02 23 40 
		15 01 00 00 00 00 02 24 40 
		15 01 00 00 00 00 02 25 6d 
		15 01 00 00 00 00 02 29 d8 
		15 01 00 00 00 00 02 2a 2a 
		15 01 00 00 00 00 02 2b 00 
		15 01 00 00 00 00 02 b6 89 
		15 01 00 00 00 00 02 b7 14 
		15 01 00 00 00 00 02 b8 05 
		15 01 00 00 00 00 02 4b 04 
		15 01 00 00 00 00 02 4c 11 
		15 01 00 00 00 00 02 4d 10 
		15 01 00 00 00 00 02 4e 01 
		15 01 00 00 00 00 02 4f 01 
		15 01 00 00 00 00 02 50 10 
		15 01 00 00 00 00 02 51 00 
		15 01 00 00 00 00 02 52 00 
		15 01 00 00 00 00 02 53 08 
		15 01 00 00 00 00 02 54 01 
		15 01 00 00 00 00 02 55 6d 
		15 01 00 00 00 00 02 5b 44 
		15 01 00 00 00 00 02 5c 00 
		15 01 00 00 00 00 02 5f 74 
		15 01 00 00 00 00 02 60 75 
		15 01 00 00 00 00 02 63 ff 
		15 01 00 00 00 00 02 64 00 
		15 01 00 00 00 00 02 67 04 
		15 01 00 00 00 00 02 68 04 
		15 01 00 00 00 00 02 6c 00 
		15 01 00 00 00 00 02 7a 80 
		15 01 00 00 00 00 02 7b 91 
		15 01 00 00 00 00 02 7c d8 
		15 01 00 00 00 00 02 7d 60 
		15 01 00 00 00 00 02 7f 15 
		15 01 00 00 00 00 02 80 00 
		15 01 00 00 00 00 02 83 00 
		15 01 00 00 00 00 02 93 08 
		15 01 00 00 00 00 02 94 0a 
		15 01 00 00 00 00 02 8a 00 
		15 01 00 00 00 00 02 9b 0f 
		15 01 00 00 00 00 02 ff 05 
		15 01 00 00 00 00 02 fb 01 
		15 01 00 00 00 00 02 e7 80 
		15 01 00 00 00 00 02 fb 01 
		15 01 00 00 00 00 02 ec 00 
		15 01 00 00 00 00 02 ff 00 
		15 01 00 00 00 00 02 d3 06 
		15 01 00 00 00 00 02 d4 04 
		15 01 00 00 00 00 02 35 00 
		15 01 00 00 00 00 02 51 ff 
		15 01 00 00 00 00 02 53 2c 
		15 01 00 00 00 00 02 55 00 
		15 01 00 00 00 00 02 ff 03 
		15 01 00 00 00 00 02 fb 01 
		15 01 00 00 00 00 02 00 23 
		15 01 00 00 00 00 02 01 26 
		15 01 00 00 00 00 02 02 2b 
		15 01 00 00 00 00 02 03 2c 
		15 01 00 00 00 00 02 04 2d 
		15 01 00 00 00 00 02 05 2d 
		15 01 00 00 00 00 02 06 30 
		15 01 00 00 00 00 02 07 30 
		15 01 00 00 00 00 02 08 32 
		15 01 00 00 00 00 02 09 32 
		15 01 00 00 00 00 02 0a 32 
		15 01 00 00 00 00 02 0b 32 
		15 01 00 00 00 00 02 0c 37 
		15 01 00 00 00 00 02 0d 3c 
		15 01 00 00 00 00 02 0e 50 
		15 01 00 00 00 00 02 0f 5a 
		15 01 00 00 00 00 02 10 5a 
		15 01 00 00 00 00 02 11 5a 
		15 01 00 00 00 00 02 12 50 
		15 01 00 00 00 00 02 13 46 
		15 01 00 00 00 00 02 1b 0f 
		15 01 00 00 00 00 02 1c 14 
		15 01 00 00 00 00 02 1d 17 
		15 01 00 00 00 00 02 1e 19 
		15 01 00 00 00 00 02 1f 19 
		15 01 00 00 00 00 02 20 19 
		15 01 00 00 00 00 02 21 19 
		15 01 00 00 00 00 02 22 19 
		15 01 00 00 00 00 02 23 17 
		15 01 00 00 00 00 02 24 14 
		15 01 00 00 00 00 02 25 12 
		15 01 00 00 00 00 02 26 0f 
		15 01 00 00 00 00 02 27 0a 
		15 01 00 00 00 00 02 28 0a 
		15 01 00 00 00 00 02 29 08 
		15 01 00 00 00 00 02 2a 05 
		15 01 00 00 00 00 02 2b 05 
		15 01 00 00 00 00 02 2f 05 
		15 01 00 00 00 00 02 30 05 
		15 01 00 00 00 00 02 31 03 
		15 01 00 00 00 00 02 32 9e 
		15 01 00 00 00 00 02 33 a3 
		15 01 00 00 00 00 02 34 a6 
		15 01 00 00 00 00 02 35 08 
		15 01 00 00 00 00 02 36 0a 
		15 01 00 00 00 00 02 37 0c 
		15 01 00 00 00 00 02 38 0e 
		15 01 00 00 00 00 02 39 10 
		15 01 00 00 00 00 02 3a 12 
		15 01 00 00 00 00 02 3b 14 
		15 01 00 00 00 00 02 3f 16 
		15 01 00 00 00 00 02 40 18 
		15 01 00 00 00 00 02 41 1a 
		15 01 00 00 00 00 02 42 18 
		15 01 00 00 00 00 02 43 16 
		15 01 00 00 00 00 02 44 14 
		15 01 00 00 00 00 02 45 12 
		15 01 00 00 00 00 02 46 10 
		15 01 00 00 00 00 02 47 0e 
		15 01 00 00 00 00 02 48 0c 
		15 01 00 00 00 00 02 49 0a 
		15 01 00 00 00 00 02 4a 08 
		15 01 00 00 00 00 02 4b a6 
		15 01 00 00 00 00 02 4c a2 
		15 01 00 00 00 00 02 4d 06 
		15 01 00 00 00 00 02 4e 08 
		15 01 00 00 00 00 02 4f 0a 
		15 01 00 00 00 00 02 1a 00 
		15 01 00 00 00 00 02 53 07 
		15 01 00 00 00 00 02 54 77 
		15 01 00 00 00 00 02 55 77 
		15 01 00 00 00 00 02 5b 70 
		15 01 00 00 00 00 02 58 ef 
		15 01 00 00 00 00 02 5f 24 
		15 01 00 00 00 00 02 63 00 
		15 01 00 00 00 00 02 ff 00 
		15 01 00 00 00 00 02 fb 01 
		15 01 00 00 00 00 02 55 80 
		05 01 00 00 78 00 02 11 00 
		05 01 00 00 0a 00 02 29 00
		];
		qcom,mdss-dsi-off-command = [05 01 00 00 32 00 02 28 00
					05 01 00 00 78 00 02 10 00];

		qcom,mdss-dsi-on-command-state = "dsi_lp_mode";
		qcom,mdss-dsi-off-command-state = "dsi_hs_mode";
		qcom,mdss-dsi-h-sync-pulse = <1>;
		qcom,mdss-dsi-traffic-mode = "non_burst_sync_event";
		qcom,mdss-dsi-lane-map = "lane_map_3012";
		qcom,mdss-dsi-bllp-eof-power-mode;
		qcom,mdss-dsi-bllp-power-mode;
		qcom,mdss-dsi-lane-0-state;
		qcom,mdss-dsi-lane-1-state;
		qcom,mdss-dsi-lane-2-state;
		qcom,mdss-dsi-lane-3-state;
		qcom,mdss-dsi-panel-timings = [f9 3d 34 00 58 4d 36 3f 53 03 04 00];
		qcom,mdss-dsi-t-clk-post = <0x1e>;
		qcom,mdss-dsi-t-clk-pre = <0x38>;
		qcom,mdss-dsi-bl-min-level = <11>;
		qcom,mdss-dsi-bl-max-level = <255>;
		qcom,mdss-dsi-interleave-mode = <0>;
		qcom,mdss-dsi-dma-trigger = "trigger_sw";
		qcom,mdss-dsi-mdp-trigger = "none";

		qcom,mdss-dsi-bl-pmic-control-type = "bl_ctrl_pwm";
		qcom,mdss-dsi-bl-pmic-pwm-frequency = <255>;		/*TCTNB.CY, PR-891676, modify for backlight blink*/
		qcom,mdss-dsi-bl-pmic-bank-select = <0>;
		qcom,mdss-dsi-pwm-gpio = <&pm8916_mpps 4 0>;
		qcom,cont-splash-enabled;
		qcom,mdss-dsi-lp11-init;

/* [PLATFORM]-Mod-BEGIN by TCTNB.CY, CR-990241, 2015/4/30, enable esd check*/
		qcom,esd-check-enabled;
		qcom,mdss-dsi-panel-status-command = [
			06 01 00 01 05 00 01 0a
		];
		qcom,mdss-dsi-panel-status-command-state = "dsi_lp_mode";
		qcom,mdss-dsi-panel-status-check-mode = "reg_read";
		qcom,mdss-dsi-panel-status-value = <0x9c 0x00 0x00 0x00 0x00 0x00 0x00 0x00 0x00 0x00>;
/* [PLATFORM]-Mod-END by TCTNB.CY, 2015/4/30*/

		qcom,mdss-dsi-reset-sequence = <1 20>, <0 20>, <1 20>;

	};
};
